#include "gui_button.h"

const uint16_t buttonBitmap_Act[] = {
	0xef7e, 0xef7e, 0xef7e, 0xef7e, 0xef7e, 0xef7e, 0xef7e, 0xef7e, 0xef7e,
		0xb6dc, 0x6e3a, 0x3db8, 0x1d57, 0x0d36, 0x0516, 0x0516, 0x0516, 0x0516,
		0x0516, 0x0516, 0x0516, 0x0516, 0x0516, 0x0516, 0x0516, 0x0516, 0x0516,
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		0xef7e, 0xef7e, 0xef7e
};

const uint16_t buttonBitmap_Prog[] = {
	0xef7e, 0xef7e, 0xef7e, 0xef7e, 0xef7e, 0xef7e, 0xef7e, 0xef7e, 0xef7e,
		0xb6dc, 0x6e3a, 0x3db8, 0x1d57, 0xd36, 0x516, 0x516, 0x516, 0x516,
		0x516, 0x516, 0x516, 0x516, 0x516, 0x516, 0x516, 0x516, 0x516, 0x516,
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		0xef7e,
};

const uint16_t buttonBitmap_Up[] = {
	0xef7e, 0xef7e, 0xef7e, 0xef7e, 0xef7e, 0xef7e, 0xef7e, 0xef7e, 0xef7e,
		0xb6dc, 0x6e3a, 0x3db8, 0x1d57, 0xd36, 0x516, 0x516, 0x516, 0x516,
		0x516, 0x516, 0x516, 0x516, 0x516, 0x516, 0x516, 0x516, 0x516, 0x516,
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		0xef7e,
};

const uint16_t buttonBitmap_Down[] = {
	0xef7e, 0xef7e, 0xcf3d, 0x1557, 0xc75d, 0xffff, 0xffff, 0xffff, 0xffff,
		0xffff, 0xffff, 0xffff, 0xffff, 0xffff, 0xffff, 0xffff, 0xffff, 0xffff,
		0xffff, 0xffff, 0xffff, 0xffff, 0xffff, 0xffff, 0xffff, 0xffff, 0xffff,
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		0xef7e,
};

const uint16_t buttonBitmap_Left[] = {
	0xef7e, 0xef7e, 0xef7e, 0xef7e, 0xef7e, 0xef7e, 0xef7e, 0xef7e, 0xef7e,
		0xb6dc, 0x6e3a, 0x3db8, 0x1d57, 0xd36, 0x516, 0x516, 0x516, 0x516,
		0x516, 0x516, 0x516, 0x516, 0x516, 0x516, 0x516, 0x516, 0x516, 0x516,
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		0xef7e,
};

const uint16_t buttonBitmap_Right[] = {
	0xef7e, 0xef7e, 0xef7e, 0xef7e, 0xef7e, 0xef7e, 0xef7e, 0xef7e, 0xef7e,
		0xb6dc, 0x6e3a, 0x3db8, 0x1d57, 0xd36, 0x516, 0x516, 0x516, 0x516,
		0x516, 0x516, 0x516, 0x516, 0x516, 0x516, 0x516, 0x516, 0x516, 0x516,
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		0xef7e,
};

const uint16_t buttonBitmap_Enter[] = {
	0xef7e, 0xef7e, 0xef7e, 0xef7e, 0xef7e, 0xef7e, 0xef7e, 0xef7e, 0xef7e,
		0xb6dc, 0x6e3a, 0x3db8, 0x1d57, 0xd36, 0x516, 0x516, 0x516, 0x516,
		0x516, 0x516, 0x516, 0x516, 0x516, 0x516, 0x516, 0x516, 0x516, 0x516,
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		0xef7e,
};

const uint16_t buttonBitmap_Reset[] = {
	0xef7e, 0xef7e, 0xef7e, 0xef7e, 0xef7e, 0xef7e, 0xef7e, 0xef7e, 0xef7e,
		0xb6dc, 0x6e3a, 0x3db8, 0x1d57, 0xd36, 0x516, 0x516, 0x516, 0x516,
		0x516, 0x516, 0x516, 0x516, 0x516, 0x516, 0x516, 0x516, 0x516, 0x516,
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		0xef7e,
};

const uint16_t buttonBitmap_Alarm[] = {
	0xef7e, 0xef7e, 0xef7e, 0xef7e, 0xef7e, 0xef7e, 0xef7e, 0xef7e, 0xef7e,
		0xb6dc, 0x6e3a, 0x3db8, 0x1d57, 0xd36, 0x516, 0x516, 0x516, 0x516,
		0x516, 0x516, 0x516, 0x516, 0x516, 0x516, 0x516, 0x516, 0x516, 0x516,
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		0xef7e,
};

const uint16_t buttonBitmap_Push[] = {
	0xef7e, 0xef7e, 0xef7e, 0xef7e, 0xef7e, 0xef7e, 0xef7e, 0xef7e, 0xef7e,
		0xb6dc, 0x6e3a, 0x3db8, 0x1d57, 0xd36, 0x516, 0x516, 0x516, 0x516,
		0x516, 0x516, 0x516, 0x516, 0x516, 0x516, 0x516, 0x516, 0x516, 0x516,
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		0xef7e,
};

static inline const uint16_t *GetButtonPixel(KeyEnum_t type)
{
	GUI_INDEX(BUTTON_PIXEL, type)
    return NULL;
}

extern uint32_t ulHighFrequencyTimerTicks;

buttonObj_t *buttonHead = NULL;
buttonObj_t *buttonEnd = NULL;

static void Gui_DrawButton(buttonObj_t * button, bool push)
{
	uint16_t x1, x2, y1, y2;

	x1 = button->x;
	y1 = button->y;
	x2 = x1 + button->size_x - 1;
	y2 = y1 + button->size_y - 1;

	button->drawer(x1, y1, x2, y2, push ? button->pixel_push : button->pixel_origin);
}

#define PUSH_TIMEOUT (600)
void Gui_CreateButton(KeyEnum_t type, uint16_t x, uint16_t y, Drawer drawer, Tick tick)
{
	buttonObj_t *NewButton = (buttonObj_t *) malloc(sizeof(buttonObj_t));

	if (NewButton == NULL) {
		//uartprintf("Failed to create button\r\n");
	}

	NewButton->toUpdate = true;
	NewButton->type = type;
	NewButton->pixel_origin = GetButtonPixel(type);
	NewButton->pixel_push = buttonBitmap_Push;
	NewButton->x = x;
	NewButton->y = y;
	NewButton->size_x = BUTTON_SIZE_X;
	NewButton->size_y = BUTTON_SIZE_Y;
	NewButton->size_total = (uint32_t) NewButton->size_x * NewButton->size_y;
	NewButton->drawer = drawer;
  NewButton->pushed = false;
  NewButton->push_timer_start = 0;
  NewButton->push_timer = 0;
  NewButton->push_timeout = PUSH_TIMEOUT;
  NewButton->tick = tick;

	if (buttonHead == NULL) {
		buttonHead = NewButton;
		buttonEnd = buttonHead;
		buttonEnd->next = NULL;
		NewButton = NULL;
	} else {
		buttonEnd->next = NewButton;
		buttonEnd = NewButton;
		buttonEnd->next = NULL;
		NewButton = NULL;
	}
}

void Gui_PushButton(KeyEnum_t type)
{
  buttonObj_t *buttonObj = buttonHead;

  while (buttonObj) {
    if (buttonObj->type == type) {
      buttonObj->pushed = true;
      buttonObj->toUpdate = true;
      buttonObj->push_timer_start = buttonObj->tick();
      buttonObj->push_timer = buttonObj->push_timer_start;
    }
    buttonObj = buttonObj->next;
  }
}

void Gui_UpdateButton(void)
{
	buttonObj_t *buttonObj = buttonHead;

	while (buttonObj != NULL) {
		if (buttonObj->toUpdate) {
			Gui_DrawButton(buttonObj, buttonObj->pushed);
			buttonObj->toUpdate = false;
		}
    if (buttonObj->pushed) {
      buttonObj->push_timer = buttonObj->tick();
      if ((buttonObj->push_timer - buttonObj->push_timer_start) >= buttonObj->push_timeout) {
        buttonObj->pushed = false;
        buttonObj->toUpdate = true;
      }
    }
		buttonObj = buttonObj->next;
	}
}
